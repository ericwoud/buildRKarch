/dts-v1/;
/plugin/;

&pcie2x1l1 {
        pcie@0,0 {
                reg = <0x400000 0 0 0 0>;
                #address-cells = <3>;
                #size-cells = <2>;
                ranges;
                device_type = "pci";
                bus-range = <0x40 0x4f>;

                wifi: wifi@0,0 {
                        compatible = "pci14e4,449d";
                        reg = <0x410000 0 0 0 0>;
                        clocks = <&hym8563>;
                        clock-names = "lpo";
                };
        };
};

